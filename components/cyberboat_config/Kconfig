## sdkconfig.defaults
```kconfig
CONFIG_ESP_CONSOLE_USB_SERIAL_JTAG=y
CONFIG_ESPTOOLPY_FLASHSIZE_4MB=y
CONFIG_PARTITION_TABLE_SINGLE_APP=y
CONFIG_CYBERBOAT_MODE_TWIN_MOTOR_AUX_SERVO=y
# CONFIG_CYBERBOAT_ACTUATORS_ENABLED is not set
# CONFIG_CYBERBOAT_GPS_ENABLED is not set
CONFIG_CYBERBOAT_RECEIVER_PWM=y
CONFIG_CYBERBOAT_PWM_RECEIVER_CHANNEL_COUNT=4
CONFIG_CYBERBOAT_PWM_RECEIVER_CH1_GPIO=7
CONFIG_CYBERBOAT_PWM_RECEIVER_CH2_GPIO=8
CONFIG_CYBERBOAT_PWM_RECEIVER_CH3_GPIO=9
CONFIG_CYBERBOAT_PWM_RECEIVER_CH4_GPIO=10
CONFIG_CYBERBOAT_PWM_RECEIVER_MIN_PULSE_US=900
CONFIG_CYBERBOAT_PWM_RECEIVER_MAX_PULSE_US=2100
CONFIG_CYBERBOAT_PWM_RECEIVER_TIMEOUT_MS=100
CONFIG_CYBERBOAT_RECEIVER_CONSOLE_LOG=y
CONFIG_CYBERBOAT_RECEIVER_CONSOLE_LOG_INTERVAL_MS=500
CONFIG_CYBERBOAT_RC_THROTTLE_CHANNEL=1
CONFIG_CYBERBOAT_RC_STEERING_CHANNEL=0
CONFIG_CYBERBOAT_RC_ARM_CHANNEL=2
CONFIG_CYBERBOAT_RC_THROTTLE_MIN_US=1000
CONFIG_CYBERBOAT_RC_THROTTLE_CENTER_US=1500
CONFIG_CYBERBOAT_RC_THROTTLE_MAX_US=2000
CONFIG_CYBERBOAT_RC_STEERING_MIN_US=1000
CONFIG_CYBERBOAT_RC_STEERING_CENTER_US=1500
CONFIG_CYBERBOAT_RC_STEERING_MAX_US=2000
CONFIG_CYBERBOAT_RC_DEADBAND_US=30
CONFIG_CYBERBOAT_RC_DRIVE_SERVO_CHANNEL=0
CONFIG_CYBERBOAT_RC_DRIVE_THROTTLE_CHANNEL=1
CONFIG_CYBERBOAT_RC_DRIVE_DIRECTION_CHANNEL=2
CONFIG_CYBERBOAT_RC_DRIVE_STEERING_CHANNEL=3
CONFIG_CYBERBOAT_RC_DRIVE_LEFT_MOTOR_INDEX=0
CONFIG_CYBERBOAT_RC_DRIVE_DEADBAND_US=30
CONFIG_CYBERBOAT_RC_DRIVE_SERVO_TRAVEL_PERCENT=50
CONFIG_CYBERBOAT_RC_DRIVE_SERVO_MIN_US=976
CONFIG_CYBERBOAT_RC_DRIVE_SERVO_CENTER_US=1492
CONFIG_CYBERBOAT_RC_DRIVE_SERVO_MAX_US=1933
CONFIG_CYBERBOAT_RC_DRIVE_THROTTLE_MIN_US=1056
CONFIG_CYBERBOAT_RC_DRIVE_THROTTLE_CENTER_US=1377
CONFIG_CYBERBOAT_RC_DRIVE_THROTTLE_MAX_US=1698
CONFIG_CYBERBOAT_RC_DRIVE_DIRECTION_MIN_US=1096
CONFIG_CYBERBOAT_RC_DRIVE_DIRECTION_CENTER_US=1472
CONFIG_CYBERBOAT_RC_DRIVE_DIRECTION_MAX_US=1924
CONFIG_CYBERBOAT_RC_DRIVE_STEERING_MIN_US=993
CONFIG_CYBERBOAT_RC_DRIVE_STEERING_CENTER_US=1508
CONFIG_CYBERBOAT_RC_DRIVE_STEERING_MAX_US=1950
CONFIG_CYBERBOAT_STATUS_LED_GPIO=21
```
